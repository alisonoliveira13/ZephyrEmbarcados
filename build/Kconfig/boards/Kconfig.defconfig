## build/Kconfig/boards/Kconfig.defconfig
```kconfig
# Load Zephyr board defconfig descriptions.
osource "C:/Users/aliso/zephyrproject/zephyr/boards/st/stm32f429i_disc1/Kconfig.defconfig"
```

## build/Kconfig/boards/Kconfig.sysbuild
```kconfig
# Load Sysbuild board Kconfig descriptions.
osource "C:/Users/aliso/zephyrproject/zephyr/boards/st/stm32f429i_disc1/Kconfig.sysbuild"
```
